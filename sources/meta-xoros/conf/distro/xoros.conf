## sources/meta-xoros/conf/distro/xoros.conf
```bitbake
include conf/distro/poky.conf

include machines/qemux86_64.inc
include machines/generic86_64.inc

DISTRO = "xoros"
DISTRO_NAME = "Xoros"
DISTRO_VERSION = "1.0"
SDK_VENDOR = "-xorosdk"
SDK_VERSION="${DISTRO_VERSION}"
MAINTAINER = "info@xoros.io"
TARGET_VENDOR = "-xoros"

# Override these in poky based distros

XOROS_DEFAULT_DISTRO_FEATURES = "bluetooth wifi ipv6 wayland opengl directfb pci usbhost"
XOROS_DEFAULT_EXTRA_RDEPENDS = "packagegroup-core-boot"
XOROS_DEFAULT_EXTRA_RRECOMMENDS = "kernel-module-af-packet"

DISTRO_EXTRA_RDEPENDS += " ${XOROS_DEFAULT_EXTRA_RDEPENDS}"
DISTRO_EXTRA_RRECOMMENDS += " ${XOROS_DEFAULT_EXTRA_RRECOMMENDS}"

### https://docs.yoctoproject.org/ref-manual/features.html#ref-features-distro
DISTRO_FEATURES += "${XOROS_DEFAULT_DISTRO_FEATURES} ${DISTRO_FEATURES_LIBC} "

PACKAGE_CLASSES = "package_deb"

# Use systemd as init manager
DISTRO_FEATURES += "systemd rauc"
DISTRO_FEATURES_BACKFILL_CONSIDERED += "sysvinit"
VIRTUAL-RUNTIME_init_manager = "systemd"
VIRTUAL-RUNTIME_initscripts = "systemd-compat-units"
```

## sources/meta-xoros/conf/layer.conf
```bitbake
## We have a conf and classes directory, add to BBPATH
BBPATH .= ":${LAYERDIR}"

## We have recipes-* directories, add to BBFILES
BBFILES += "${LAYERDIR}/recipes-*/*/*.bb \
            ${LAYERDIR}/recipes-*/*/*.bbappend"

BBFILE_COLLECTIONS += "xoros"
BBFILE_PATTERN_xoros = "^${LAYERDIR}/"
BBFILE_PRIORITY_xoros = "99"

LAYERDEPENDS_xoros = "core"
LAYERSERIES_COMPAT_xoros = "kirkstone"

BUGTRACKER = "https://github.com/xoros-repo/xoros-distro/issues"

## so we are including platform-specific bbappend files based on collection names available
## BBFILE_COLLECTIONS += "variscite-imx"
## BBFILE_COLLECTIONS += "raspberrypi"
BBFILES_DYNAMIC += "\
    variscite-imx:${LAYERDIR}/dynamic-layers/meta-variscite-fslc/recipes-*/*/*.bbappend \
    variscite-imx:${LAYERDIR}/dynamic-layers/meta-variscite-fslc/recipes-*/*/*/*.bbappend \
    variscite-imx:${LAYERDIR}/dynamic-layers/meta-variscite-fslc/recipes-*/*/*.bb \
    variscite-imx:${LAYERDIR}/dynamic-layers/meta-variscite-fslc/recipes-*/*/*/*.bb \
    raspberrypi:${LAYERDIR}/dynamic-layers/meta-raspberrypi/recipes-*/*/*.bbappend \
    raspberrypi:${LAYERDIR}/dynamic-layers/meta-raspberrypi/recipes-*/*/*/*.bbappend \
    raspberrypi:${LAYERDIR}/dynamic-layers/meta-raspberrypi/recipes-*/*/*.bb \
    raspberrypi:${LAYERDIR}/dynamic-layers/meta-raspberrypi/recipes-*/*/*/*.bb \
"
```

## sources/meta-xoros/conf/local.conf
```bitbake
EXTRA_IMAGE_FEATURES ?= "debug-tweaks"
CORE_IMAGE_EXTRA_INSTALL += " openssh"
IMAGE_INSTALL_append = " rauc chromium-x11"

USER_CLASSES ?= "buildstats image-mklibs image-prelink"

# Supported values are auto, gnome, xfce, rxvt, screen, konsole (KDE 3.x only), none
#OE_TERMINAL = "auto"

PATCHRESOLVE = "noop"

DISTRO_FEATURES_append = " rauc systemd"
DISTRO_FEATURES_BACKFILL_CONSIDERED += "sysvinit"
VIRTUAL-RUNTIME_init_manager = "systemd"
VIRTUAL-RUNTIME_initscripts = "systemd-compat-units"

PREFERRED_PROVIDER_virtual/bootloader = "u-boot"

BB_DISKMON_DIRS ??= "\
    STOPTASKS,${TMPDIR},1G,100K \
    STOPTASKS,${DL_DIR},1G,100K \
    STOPTASKS,${SSTATE_DIR},1G,100K \
    STOPTASKS,/tmp,100M,100K \
    ABORT,${TMPDIR},100M,1K \
    ABORT,${DL_DIR},100M,1K \
    ABORT,${SSTATE_DIR},100M,1K \
    ABORT,/tmp,10M,1K"
```

## sources/meta-xoros/wic/genericx86-64.wks
```
# https://docs.yoctoproject.org/ref-manual/kickstart.html

bootloader --ptable gpt --timeout=5 --append="rw oprofile.timer=1 rootfstype=squashfs"

# sda1 = boot partition:
part /boot --source bootimg-biosplusefi --sourceparams="loader=grub-efi,label=boot" --ondisk sda --label boot --active --fixed-size 64M

# sda2 = primary rootfs partition
part / --source rootfs --use-uuid --fstype squashfs --part-name rootfs_a --fixed-size 1G

# sda3 = secondary roots partition:
part --source rootfs --use-uuid --fstype squashfs --part-name rootfs_b --fixed-size 1G

# sda4 = reserved for recovery partition:
part --use-uuid --fstype ext4 --part-name reserve-recovery --fixed-size 704M

# sda5 = overlay partition (it will be mounted by overlay.inc):
part --use-uuid --fstype ext4 --part-name non-volatile --label non-volatile --fsoptions="defaults" --fixed-size 256M

# sda6 = persistent app partition
part --use-uuid --fstype ext4 --part-name application --fixed-size 5G
```

## sources/meta-xoros/wic/qemux86-64-efi.wks
```
# https://docs.yoctoproject.org/ref-manual/kickstart.html

bootloader --ptable gpt --timeout=5 --append="oprofile.timer=1" --configfile="grub_rauc.cfg"

# sda1 = boot partition:
part /boot --source bootimg-efi-grubenv --ondisk sda --rootfs-dir=${IMAGE_ROOTFS}/boot --sourceparams="loader=grub-efi" --active --fixed-size 64M

# sda2 = primary rootfs partition
part / --source rootfs --use-uuid --fstype squashfs --part-name rootfs_a --fixed-size 1G

# sda3 = secondary roots partition:
part --source rootfs --use-uuid --fstype squashfs --part-name rootfs_b --fixed-size 1G

# sda4 = reserved for rescue partition:
part --use-uuid --fstype ext4 --part-name rescue --fixed-size 704M

# sda5 = overlay partition (it will be mounted by overlay.inc):
part --use-uuid --fstype ext4 --part-name persistent --label persistent --fsoptions="defaults" --fixed-size 256M

# sda6 = persistent app partition
part --use-uuid --fstype ext4 --part-name application --fixed-size 5G
```

## sources/meta-xoros/wic/qemux86-64.wks
```
# https://docs.yoctoproject.org/ref-manual/kickstart.html

bootloader --ptable msdos --timeout=5 --append="rootfstype=ext4 console=ttyS0,115200 earlyprintk=serial,ttyS0,115200"

part /boot --source bootimg-grub --ondisk sda --label boot --active --align 1024
part / --source rootfs --use-uuid --fstype ext4 --label rootfs_a --fsoptions="defaults,ro" --fixed-size 1G
part --source rootfs --use-uuid --fstype ext4 --label rootfs_b --fsoptions="defaults,ro" --fixed-size 1G
part --use-uuid --fstype ext4 --label recovery --fixed-size 704M
part --use-uuid --fstype ext4 --label persistent --fsoptions="defaults" --fixed-size 256M
part --use-uuid --fstype ext4 --label application --fixed-size 5G
```
